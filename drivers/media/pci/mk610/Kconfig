## drivers/media/pci/mk610/Kconfig
```kconfig
config DVB_MK610
	tristate "MK610 FPGA based cards"
	depends on DVB_CORE && PCI && I2C
	select I2C_ALGOBIT
	select DVB_MXL58X if MEDIA_SUBDRV_AUTOSELECT
	help
	  Support for cards with MK610 FPGA based PCIe bridge.

	  Say Y or M if you own such a device and want to use it.
	  If unsure say N.
```
